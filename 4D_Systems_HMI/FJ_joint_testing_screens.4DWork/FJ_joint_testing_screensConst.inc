// File generated 10/23/2024 2:49:55 PM
// Warning! This is a generated file, any manual changes will be
// lost during the next generation.

#constant  Strings0Count    1
#constant  Strings0Size     13
#constant  Strings1Count    0
#constant  Strings1Size     1
#constant  Strings2Count    0
#constant  Strings2Size     1
#constant  Strings3Count    0
#constant  Strings3Size     1
#constant  Strings4Count    0
#constant  Strings4Size     1
#constant  Strings5Count    0
#constant  Strings5Size     1
#constant  Strings6Count    0
#constant  Strings6Size     1
#constant  Strings7Count    0
#constant  Strings7Size     1
#constant  Strings8Count    0
#constant  Strings8Size     1
#constant  Strings9Count    0
#constant  Strings9Size     1
#constant  Strings10Count    0
#constant  Strings10Size     1
#constant  Strings12Count    1
#constant  Strings12Size     13
#constant  Strings13Count    1
#constant  Strings13Size     13
#constant  Strings14Count    1
#constant  Strings14Size     13
#constant  Strings15Count    0
#constant  Strings15Size     1
#constant  Strings16Count    0
#constant  Strings16Size     1
#constant  Strings17Count    0
#constant  Strings17Size     1
#constant  Strings18Count    0
#constant  Strings18Size     1
#constant  Strings11Count    1
#constant  Strings11Size     52
#DATA
    byte iKeyboard0keystrokes 0x01, 0x02, 0x03, 0x04, 0x05, 0x09, 0x0A, 0x0B, 0x0C, 0x0D, 0x0E, 0x41, 0x42, 0x43, 0x44, 0x45,
                              0x46, 0x47, 0x48, 0x49, 0x15, 0x16, 0x17, 0x18, 0x19, 0x1A, 0x1B, 0x08, 0x30, 0x31, 0x32, 0x33,
                              0x35, 0x36, 0x37, 0x38, 0x39, 0x34, 0x2D, 0x2B, 0x6A, 0x62, 0x63, 0x4A, 0x4B, 0x4C, 0x4D, 0x4E,
                              0x4F, 0x50, 0x51, 0x52, 0x53, 0x54, 0x55, 0x56, 0x57, 0x58, 0x59, 0x5A
#END


#constant  IFONT_OFFSET     19
// object indexes into ImageControl
#CONST
    iKeyboard0      // offset 0x0
    iKeyboard0_0    // offset 0x59E00
    iKeyboard0_1    // offset 0x5CA00
    iKeyboard0_2    // offset 0x5F600
    iKeyboard0_3    // offset 0x62200
    iKeyboard0_4    // offset 0x64600
    iKeyboard0_5    // offset 0x66A00
    iKeyboard0_6    // offset 0x6A000
    iKeyboard0_7    // offset 0x6D600
    iKeyboard0_8    // offset 0x70C00
    iKeyboard0_9    // offset 0x72800
    iKeyboard0_10   // offset 0x74400
    iKeyboard0_11   // offset 0x78C00
    iKeyboard0_12   // offset 0x7B000
    iKeyboard0_13   // offset 0x7D400
    iKeyboard0_14   // offset 0x7F800
    iKeyboard0_15   // offset 0x81C00
    iKeyboard0_16   // offset 0x84000
    iKeyboard0_17   // offset 0x86400
    iKeyboard0_18   // offset 0x88800
    iKeyboard0_19   // offset 0x8AC00
    iKeyboard0_20   // offset 0x8D000
    iKeyboard0_21   // offset 0x90600
    iKeyboard0_22   // offset 0x93C00
    iKeyboard0_23   // offset 0x97200
    iKeyboard0_24   // offset 0x9B200
    iKeyboard0_25   // offset 0x9F200
    iKeyboard0_26   // offset 0xA1E00
    iKeyboard0_27   // offset 0xA4A00
    iKeyboard0_28   // offset 0xA9200
    iKeyboard0_29   // offset 0xADA00
    iKeyboard0_30   // offset 0xB2200
    iKeyboard0_31   // offset 0xB6A00
    iKeyboard0_32   // offset 0xBB200
    iKeyboard0_33   // offset 0xBFA00
    iKeyboard0_34   // offset 0xC4200
    iKeyboard0_35   // offset 0xC8A00
    iKeyboard0_36   // offset 0xCD200
    iKeyboard0_37   // offset 0xD1A00
    iKeyboard0_38   // offset 0xD6200
    iKeyboard0_39   // offset 0xD8600
    iKeyboard0_40   // offset 0xDAA00
    iKeyboard0_41   // offset 0xDF200
    iKeyboard0_42   // offset 0xE3A00
    iKeyboard0_43   // offset 0xE8200
    iKeyboard0_44   // offset 0xEA600
    iKeyboard0_45   // offset 0xECA00
    iKeyboard0_46   // offset 0xEEE00
    iKeyboard0_47   // offset 0xF1200
    iKeyboard0_48   // offset 0xF3600
    iKeyboard0_49   // offset 0xF5A00
    iKeyboard0_50   // offset 0xF7E00
    iKeyboard0_51   // offset 0xFA200
    iKeyboard0_52   // offset 0xFC600
    iKeyboard0_53   // offset 0xFEA00
    iKeyboard0_54   // offset 0x100E00
    iKeyboard0_55   // offset 0x103200
    iKeyboard0_56   // offset 0x105600
    iKeyboard0_57   // offset 0x107A00
    iKeyboard0_58   // offset 0x109E00
    iKeyboard0_59   // offset 0x10C200
    iStatictext0    // offset 0x10E600
    iStatictext1    // offset 0x10F800
    iStatictext2    // offset 0x110600
    iStatictext3    // offset 0x110E00
    iStatictext4    // offset 0x111600
    iStatictext5    // offset 0x111E00
    iStatictext6    // offset 0x112C00
    iStatictext7    // offset 0x113600
    iStatictext8    // offset 0x114800
    iStatictext9    // offset 0x116000
    iLed0           // offset 0x117600
    iLed1           // offset 0x117E00
    iLed2           // offset 0x118600
    iLed3           // offset 0x118E00
    iLed4           // offset 0x119600
    iLed5           // offset 0x119E00
    iLed6           // offset 0x11A600
    iLed7           // offset 0x11AE00
    iLed8           // offset 0x11B600
    iLed9           // offset 0x11BC00
    i4Dbutton1      // offset 0x11C400
    iStatictext10   // offset 0x120600
    i4Dbutton0      // offset 0x120C00
    iStatictext12   // offset 0x124E00
    iStatictext22   // offset 0x125400
    iStatictext23   // offset 0x126600
    iStatictext24   // offset 0x127C00
    iStatictext25   // offset 0x129000
    iStatictext26   // offset 0x12A600
    iLed10          // offset 0x12B600
    iLed11          // offset 0x12BE00
    iLed12          // offset 0x12C600
    iLed13          // offset 0x12CE00
    iLed14          // offset 0x12D600
    iStatictext31   // offset 0x12DE00
    iStatictext32   // offset 0x12E800
    iStatictext33   // offset 0x12EE00
    iStatictext34   // offset 0x12F400
    iStatictext35   // offset 0x12FC00
    iLed15          // offset 0x130C00
    iForm1          // offset 0x131400
    iUserbutton0    // offset 0x1ECE00
    iStatictext11   // offset 0x1F6C00
    iStatictext19   // offset 0x1F7600
    iUserled5       // offset 0x1F7A00
    iStatictext20   // offset 0x1F8800
    iForm2          // offset 0x1F9000
    iCoolgauge1     // offset 0x2B4A00
    iCoolgauge0     // offset 0x8F21200
    iLeddigits0     // offset 0xA6BA800
    iiLeddigits0    // offset 0xA6BBC00
    iStatictext14   // offset 0xA6BE800
    iStatictext13   // offset 0xA6BF000
    iLeddigits1     // offset 0xA6BFC00
    iiLeddigits1    // offset 0xA6C1000
    iStatictext15   // offset 0xA6C3C00
    iLeddigits2     // offset 0xA6C4600
    iiLeddigits2    // offset 0xA6C5A00
    iStatictext16   // offset 0xA6C8600
    iLeddigits3     // offset 0xA6C9400
    iiLeddigits3    // offset 0xA6CA800
    i4Dbutton9      // offset 0xA6CD400
    iUserled0       // offset 0xA6CFA00
    iUserled1       // offset 0xA6D0800
    iStatictext17   // offset 0xA6D1600
    iStatictext18   // offset 0xA6D2200
    iLeddigits4     // offset 0xA6D2C00
    iiLeddigits4    // offset 0xA6D4000
    iLeddigits5     // offset 0xA6D6C00
    iiLeddigits5    // offset 0xA6D8000
    iStatictext27   // offset 0xA6DAC00
    iStatictext28   // offset 0xA6DB600
    iStatictext30   // offset 0xA6DBE00
    iImage0         // offset 0xA6DC200
    iStatictext21   // offset 0xA751600
    i4Dbutton2      // offset 0xA752400
    i4Dbutton3      // offset 0xA756E00
    i4Dbutton4      // offset 0xA75B800
    i4Dbutton5      // offset 0xA760200
    i4Dbutton6      // offset 0xA764C00
    i4Dbutton7      // offset 0xA769600
    i4Dbutton8      // offset 0xA76E000
    iStatictext29   // offset 0xA772200
#END


#constant  Strings0StartH   0x0
#constant  Strings0StartL   0x0
#constant  Strings1StartH   0x0
#constant  Strings1StartL   0x200
#constant  Strings2StartH   0x0
#constant  Strings2StartL   0x400
#constant  Strings3StartH   0x0
#constant  Strings3StartL   0x600
#constant  Strings4StartH   0x0
#constant  Strings4StartL   0x800
#constant  Strings5StartH   0x0
#constant  Strings5StartL   0xA00
#constant  Strings6StartH   0x0
#constant  Strings6StartL   0xC00
#constant  Strings7StartH   0x0
#constant  Strings7StartL   0xE00
#constant  Strings8StartH   0x0
#constant  Strings8StartL   0x1000
#constant  Strings9StartH   0x0
#constant  Strings9StartL   0x1200
#constant  Strings10StartH   0x0
#constant  Strings10StartL   0x1400
#constant  Strings12StartH   0x0
#constant  Strings12StartL   0x1600
#constant  Strings13StartH   0x0
#constant  Strings13StartL   0x1800
#constant  Strings14StartH   0x0
#constant  Strings14StartL   0x1A00
#constant  Strings15StartH   0x0
#constant  Strings15StartL   0x1C00
#constant  Strings16StartH   0x0
#constant  Strings16StartL   0x1E00
#constant  Strings17StartH   0x0
#constant  Strings17StartL   0x2000
#constant  Strings18StartH   0x0
#constant  Strings18StartL   0x2200
#constant  Strings11StartH   0x0
#constant  Strings11StartL   0x2400

#IFNOT EXISTS NOGLOBALS
var hndl ;
var hFonts[19] ;
var oKeyboard0[12] := [-1, 0, 0, 0, 0, 255, 255, 255, 255, 255, 60, 0] ;
#ENDIF
